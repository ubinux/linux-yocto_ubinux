## linux_arm32.its
```
/*
 * Copyright 2017 - 2020 NXP
 *
 */


/dts-v1/;

/ {
	description = "Image file for the QorIQ ARM 32b Linux Kernel";
	#address-cells = <1>;

	images {
		kernel-v7 {
			description = "ARM32 Linux kernel";
			data = /incbin/("./arch/arm/boot/zImage");
			type = "kernel";
			arch = "arm";
			os = "linux";
			compression = "none";
			load = <0x80008000>;
			entry = <0x80008000>;
		};

		ls1043a-rdb-dtb {
			description = "ls1043ardb-dtb";
			data = /incbin/("./arch/arm/boot/dts/fsl-ls1043a-rdb-sdk.dtb");
			type = "flat_dt";
			arch = "arm";
			compression = "none";
			load = <0x90000000>;
		};

		ls1046a-rdb-dtb {
			description = "ls1046ardb-dtb";
			data = /incbin/("./arch/arm/boot/dts/fsl-ls1046a-rdb-sdk.dtb");
			type = "flat_dt";
			arch = "arm";
			compression = "none";
			load = <0x90000000>;
		};
	};

	configurations {
		ls1043a-rdb {
			description = "config for ls1043ardb";
			kernel = "kernel-v7";
			fdt = "ls1043a-rdb-dtb";
		};

		ls1046a-rdb {
			description = "config for ls1046ardb";
			kernel = "kernel-v7";
			fdt = "ls1046a-rdb-dtb";
		};
	};
};
```

## linux_arm64.its
```
/*
 * Copyright 2017 - 2021 NXP
 *
 */


/dts-v1/;

/ {
	description = "arm64 kernel and FDT blob";
	#address-cells = <1>;

	images {
		kernel {
			description = "ARM64 Kernel";
			data = /incbin/("./arch/arm64/boot/Image.gz");
			type = "kernel";
			arch = "arm64";
			os = "linux";
			compression = "gzip";
			load = <0x84080000>;
			entry = <0x84080000>;
		};

		ls1043a-rdb-dtb {
			description = "ls1043ardb-dtb";
			data = /incbin/("./arch/arm64/boot/dts/freescale/fsl-ls1043a-rdb-sdk.dtb");
			type = "flat_dt";
			arch = "arm64";
			os = "linux";
			compression = "none";
			load = <0x90000000>;
		};

		ls1046a-rdb-dtb {
			description = "ls1046ardb-dtb";
			data = /incbin/("./arch/arm64/boot/dts/freescale/fsl-ls1046a-rdb-sdk.dtb");
			type = "flat_dt";
			arch = "arm64";
			os = "linux";
			compression = "none";
			load = <0x90000000>;
		};
	};

	configurations {
		ls1043a-rdb {
			description = "config for ls1043ardb";
			kernel = "kernel";
			fdt = "ls1043a-rdb-dtb";
		};

		ls1046a-rdb {
			description = "config for ls1046ardb";
			kernel = "kernel";
			fdt = "ls1046a-rdb-dtb";
		};
	};
};
```

## ubinux-1046a-frwy.its
```
/dts-v1/;

/ {
        description = "Kernel fitImage for QorIQ SDK (FSL Reference Distro)/6.6.23+git/ls1046afrwy";
        #address-cells = <1>;

        images {
                kernel-1 {
                        description = "Linux kernel";
                        data = /incbin/("arch/arm64/boot/Image.gz");
                        type = "kernel";
                        arch = "arm64";
                        os = "linux";
                        compression = "gzip";
                        load = <0x80080000>;
                        entry = <0x80080000>;
                        hash-1 {
                                algo = "sha256";
                        };
                };
                fdt-fsl-ls1046a-frwy-sdk.dtb {
                        description = "Flattened Device Tree blob";
                        data = /incbin/("arch/arm64/boot/dts/freescale/fsl-ls1046a-frwy-sdk.dtb");
                        type = "flat_dt";
                        arch = "arm64";
                        compression = "none";
                        load = <0x90000000>;
                        hash-1 {
                                algo = "sha256";
                        };
                };
                fdt-fsl-ls1046a-frwy-usdpaa.dtb {
                        description = "Flattened Device Tree blob";
                        data = /incbin/("arch/arm64/boot/dts/freescale/fsl-ls1046a-frwy-usdpaa.dtb");
                        type = "flat_dt";
                        arch = "arm64";
                        compression = "none";
                        load = <0x90000000>;
                        hash-1 {
                                algo = "sha256";
                        };
                };
                fdt-fsl-ls1046a-frwy.dtb {
                        description = "Flattened Device Tree blob";
                        data = /incbin/("arch/arm64/boot/dts/freescale/fsl-ls1046a-frwy.dtb");
                        type = "flat_dt";
                        arch = "arm64";
                        compression = "none";
                        load = <0x90000000>;
                        hash-1 {
                                algo = "sha256";
                        };
                };
	};

        configurations {
                default = "conf-fsl-ls1046a-frwy-sdk.dtb";
                conf-fsl-ls1046a-frwy-sdk.dtb {
                        description = "1 Linux kernel, FDT blob";
                        
                        kernel = "kernel-1";
                        fdt = "fdt-fsl-ls1046a-frwy-sdk.dtb";
                        
                        
                        
                        hash-1 {
                                algo = "sha256";
                        };
                };
                
                conf-fsl-ls1046a-frwy-usdpaa.dtb {
                        description = "0 Linux kernel, FDT blob";
                        
                        kernel = "kernel-1";
                        fdt = "fdt-fsl-ls1046a-frwy-usdpaa.dtb";
                        
                        
                        
                        hash-1 {
                                algo = "sha256";
                        };
                };
                
                conf-fsl-ls1046a-frwy.dtb {
                        description = "0 Linux kernel, FDT blob";
                        
                        kernel = "kernel-1";
                        fdt = "fdt-fsl-ls1046a-frwy.dtb";
                        
                        
                        
                        hash-1 {
                                algo = "sha256";
                        };
                };
	};
};
```

## ubinux-nxp-soc.its
```
/dts-v1/;

/ {
	description = "ubinux nxp-soc kernel and FDT blob";
	#address-cells = <1>;

	images {
		kernel {
			description = "ARM64 Kernel";
			data = /incbin/("./arch/arm64/boot/Image.gz");
			type = "kernel";
			arch = "arm64";
			os = "linux";
			compression = "gzip";
			load = <0x84000000>;
			entry = <0x84000000>;
		};

		ls1043a-rdb-dtb {
			description = "ls1043ardb-dtb";
			data = /incbin/("./arch/arm64/boot/dts/freescale/fsl-ls1043a-rdb-sdk.dtb");
			type = "flat_dt";
			arch = "arm64";
			compression = "none";
			load = <0x90000000>;
		};

		ls1046a-rdb-dtb {
			description = "ls1046ardb-dtb";
			data = /incbin/("./arch/arm64/boot/dts/freescale/fsl-ls1046a-rdb-sdk.dtb");
			type = "flat_dt";
			arch = "arm64";
			compression = "none";
			load = <0x90000000>;
		};

		lx2160a-rdb-dtb {
			description = "lx2160ardb-dtb";
			data = /incbin/("./arch/arm64/boot/dts/freescale/fsl-lx2160a-rdb.dtb");
			type = "flat_dt";
			arch = "arm64";
			compression = "none";
			load = <0x90000000>;
		};

		ls1088a-rdb-dtb {
			description = "ls1088ardb-dtb";
			data = /incbin/("./arch/arm64/boot/dts/freescale/fsl-ls1088a-rdb.dtb");
			type = "flat_dt";
			arch = "arm64";
			compression = "none";
			load = <0x90000000>;
		};

		ls1046a-frwy-dtb {
			description = "Flattened Device Tree blob";
			data = /incbin/("./arch/arm64/boot/dts/freescale/fsl-ls1046a-frwy-sdk.dtb");
			type = "flat_dt";
			arch = "arm64";
			compression = "none";
			load = <0x90000000>;
		};
	};

	configurations {
		default = "ls1046a-frwy";

		ls1043a-rdb {
			description = "config for ls1043ardb";
			kernel = "kernel";
			fdt = "ls1043a-rdb-dtb";
		};

		ls1046a-rdb {
			description = "config for ls1046ardb";
			kernel = "kernel";
			fdt = "ls1046a-rdb-dtb";
		};

		lx2160a-rdb {
			description = "config for lx2160ardb";
			kernel = "kernel";
			fdt = "lx2160a-rdb-dtb";
		};

		ls1088a-rdb {
			description = "config for ls1088ardb";
			kernel = "kernel";
			fdt = "ls1088a-rdb-dtb";
		};

		ls1046a-frwy {
			description = "config for ls1046a-frwy";
			kernel = "kernel";
			fdt = "ls1046a-frwy-dtb";
		};
	};
};
```
